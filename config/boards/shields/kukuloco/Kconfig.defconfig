## config/boards/shields/kukuloco/Kconfig.defconfig
```kconfig
if SHIELD_KUKULOCO_LEFT

config ZMK_KEYBOARD_NAME
    default "KukuLoco_white"

config ZMK_SPLIT_ROLE_CENTRAL
    default y

endif

if SHIELD_KUKULOCO_LEFT || SHIELD_KUKULOCO_RIGHT

config ZMK_SPLIT
    default y

endif
```

## config/boards/shields/kukuloco/Kconfig.shield
```kconfig
config SHIELD_TEMPER_LEFT
    def_bool $(shields_list_contains,temper_left)

config SHIELD_TEMPER_RIGHT
    def_bool $(shields_list_contains,temper_right)
```
